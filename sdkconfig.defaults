## sdkconfig.defaults
```kconfig
CONFIG_COMPILER_OPTIMIZATION_SIZE=y
# CONFIG_MESH_ENABLE_PS is not set
# CONFIG_KEEMASH_V2_COMPAT_TUNNEL_ENABLE is not set
# CONFIG_NODE0_LOSSLESS_DEBUG_ENABLE is not set
```

## sdkconfig.defaults.esp32s3
```kconfig
CONFIG_PARTITION_TABLE_TWO_OTA_LARGE=y
CONFIG_BOOTLOADER_APP_ROLLBACK_ENABLE=y
CONFIG_NODE0_STATIC_IP_ENABLE=y
CONFIG_NODE0_STATIC_IP_ADDR="192.168.1.50"
CONFIG_NODE0_STATIC_NETMASK_ADDR="255.255.255.0"
CONFIG_NODE0_STATIC_GW_ADDR="192.168.1.1"
CONFIG_NODE0_STATIC_DNS_ADDR="192.168.1.1"
CONFIG_NODE0_HTTPS_PORT=443
CONFIG_SPIRAM=y
CONFIG_SPIRAM_MODE_OCT=y
CONFIG_SPIRAM_TYPE_AUTO=y
CONFIG_SPIRAM_SPEED_40M=y
CONFIG_SPIRAM_USE_MALLOC=y
CONFIG_SPIRAM_MALLOC_ALWAYSINTERNAL=256
CONFIG_SPIRAM_TRY_ALLOCATE_WIFI_LWIP=y
CONFIG_SPIRAM_MALLOC_RESERVE_INTERNAL=32768
CONFIG_HTTPD_WS_SUPPORT=y
CONFIG_HTTPD_WS_PRE_HANDSHAKE_CB_SUPPORT=y
CONFIG_NODE0_KEELINK_ENABLE=y
CONFIG_NODE0_KEELINK_BLE_ENABLE=y
CONFIG_BT_ENABLED=y
CONFIG_BT_NIMBLE_ENABLED=y
CONFIG_BT_BLUEDROID_ENABLED=n
CONFIG_BT_NIMBLE_MAX_CONNECTIONS=1
CONFIG_BT_NIMBLE_MEM_ALLOC_MODE_EXTERNAL=y
CONFIG_BT_NIMBLE_HOST_TASK_STACK_SIZE=8192
CONFIG_BT_CTRL_BLE_MAX_ACT=2
CONFIG_BT_CTRL_DTM_ENABLE=n
CONFIG_BT_CTRL_BLE_MASTER=y
CONFIG_BT_CTRL_BLE_SCAN=n
CONFIG_BT_CTRL_BLE_SECURITY_ENABLE=n
CONFIG_BT_NIMBLE_ROLE_CENTRAL=n
CONFIG_BT_NIMBLE_ROLE_OBSERVER=n
CONFIG_BT_NIMBLE_ROLE_BROADCASTER=y
CONFIG_BT_NIMBLE_ROLE_PERIPHERAL=y
CONFIG_BT_NIMBLE_SECURITY_ENABLE=n
CONFIG_BT_NIMBLE_MAX_CCCDS=2
CONFIG_BT_NIMBLE_ATT_MAX_PREP_ENTRIES=4
CONFIG_BT_NIMBLE_GATT_MAX_PROCS=2
CONFIG_BT_NIMBLE_MSYS_1_BLOCK_COUNT=12
CONFIG_BT_NIMBLE_MSYS_2_BLOCK_COUNT=8
CONFIG_BT_NIMBLE_TRANSPORT_ACL_FROM_LL_COUNT=6
CONFIG_BT_NIMBLE_TRANSPORT_EVT_COUNT=8
CONFIG_BT_NIMBLE_TRANSPORT_EVT_DISCARD_COUNT=2
CONFIG_BT_NIMBLE_50_FEATURE_SUPPORT=n
CONFIG_BT_NIMBLE_LL_CFG_FEAT_LE_2M_PHY=n
CONFIG_BT_NIMBLE_LL_CFG_FEAT_LE_CODED_PHY=n
CONFIG_BT_NIMBLE_PROX_SERVICE=n
CONFIG_BT_NIMBLE_ANS_SERVICE=n
CONFIG_BT_NIMBLE_CTS_SERVICE=n
CONFIG_BT_NIMBLE_HTP_SERVICE=n
CONFIG_BT_NIMBLE_IPSS_SERVICE=n
CONFIG_BT_NIMBLE_TPS_SERVICE=n
CONFIG_BT_NIMBLE_IAS_SERVICE=n
CONFIG_BT_NIMBLE_LLS_SERVICE=n
CONFIG_BT_NIMBLE_SPS_SERVICE=n
CONFIG_BT_NIMBLE_HR_SERVICE=n
CONFIG_BT_NIMBLE_BAS_SERVICE=n
CONFIG_BT_NIMBLE_DIS_SERVICE=n
CONFIG_BT_NIMBLE_DTM_MODE_TEST=n
CONFIG_BT_NIMBLE_SM_SIGN_CNT=n
CONFIG_BT_NIMBLE_CPFD_CAFD=n
CONFIG_BT_NIMBLE_RECONFIG_MTU=n
CONFIG_BT_NIMBLE_LOW_SPEED_MODE=y
CONFIG_ESP_COEX_SW_COEXIST_ENABLE=y
CONFIG_ESP_WIFI_TASK_PINNED_TO_CORE_0=y
CONFIG_BT_CTRL_PINNED_TO_CORE_1=y
CONFIG_BT_NIMBLE_PINNED_TO_CORE_1=y
CONFIG_MBEDTLS_ASYMMETRIC_CONTENT_LEN=y
CONFIG_MBEDTLS_SSL_IN_CONTENT_LEN=16384
CONFIG_MBEDTLS_SSL_OUT_CONTENT_LEN=4096
CONFIG_MBEDTLS_DYNAMIC_BUFFER=y
CONFIG_MBEDTLS_DEFAULT_MEM_ALLOC=y
# CONFIG_MBEDTLS_HARDWARE_AES is not set
```
